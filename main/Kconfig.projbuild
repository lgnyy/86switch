## main/Kconfig.projbuild
```kconfig
menu "Switch86 Configuration"
    menu "Touch Controller"
        config SWITCH86_LCD_TOUCH_CONTROLLER_GT911
            bool "Enable LCD GT911 Touch"
            default "y"
            help
                Enable this option if you wish to use display touch.
    endmenu

    menu "Display"
        config SWITCH86_LCD_RGB_BOUNCE_BUFFER_HEIGHT
            int "RGB Bounce buffer height"
            default 10
            help
                Height of bounce buffer. The width of the buffer is the same as that of the LCD.

        config SWITCH86_LVGL_PORT_TASK_MAX_DELAY_MS
            int "LVGL timer task maximum delay (ms)"
            default 500
            range 2 2000  # Switch86 range, adjust as needed
            help
            The maximum delay of the LVGL timer task, in milliseconds.

        config SWITCH86_LVGL_PORT_TASK_MIN_DELAY_MS
            int "LVGL timer task minimum delay (ms)"
            default 10
            range 1 100  # Switch86 range, adjust as needed
            help
            The minimum delay of the LVGL timer task, in milliseconds.

        config SWITCH86_LVGL_PORT_TASK_PRIORITY
            int "LVGL task priority"
            default 2
            help
                The Board Support Package will create a task that will periodically handle LVGL operation in lv_timer_handler().

        config SWITCH86_LVGL_PORT_TASK_STACK_SIZE_KB
            int "LVGL task stack size (KB)"
            default 16
            help
                Size(KB) of LVGL task stack.

        config SWITCH86_LVGL_PORT_TASK_CORE
            int "LVGL timer task core"
            default -1
            range -1 1
            help
            The core of the LVGL timer task.
            Set to -1 to not specify the core.
            Set to 1 only if the SoCs support dual-core, otherwise set to -1 or 0.

        choice
            prompt "Select LVGL buffer memory capability"
            default SWITCH86_LVGL_PORT_BUF_INTERNAL
            config SWITCH86_LVGL_PORT_BUF_PSRAM
                bool "PSRAM memory"
            config SWITCH86_LVGL_PORT_BUF_INTERNAL
                bool "Internal memory"
        endchoice

        config SWITCH86_LVGL_PORT_BUF_HEIGHT
            depends on !SWITCH86_LVGL_PORT_AVOID_TEAR_ENABLE
            int "LVGL buffer height"
            default 48
            help
                Height of LVGL buffer. The width of the buffer is the same as that of the LCD.
    endmenu

    menu "I2S MEMS MIC Configuration"
        config SWITCH86_MIC_INMP411_ENABLE
            bool "Enable MIC INMP411"
            default "y"
            help
                Enable this option if you wish to use mic.

        config SWITCH86_MIC_INMP411_I2S_DATA_GPIO
            depends on SWITCH86_MIC_INMP411_ENABLE
            int "I2S Data GPIO"
            default 2
            help
                Set the GPIO number used for transmitting/receiving data from I2S.

        config SWITCH86_MIC_INMP411_I2S_CLK_GPIO
            depends on SWITCH86_MIC_INMP411_ENABLE
            int "I2S Clock GPIO"
            default 1
            help
                Set the GPIO number used for the clock line from I2S.

        config SWITCH86_MIC_INMP411_I2S_WS_GPIO
            depends on SWITCH86_MIC_INMP411_ENABLE
            int "I2S WS GPIO"
            default 40
            help
                Set the GPIO number used for WS from I2S.

        config SWITCH86_ASR_WEBSOCKET_URL
            depends on SWITCH86_MIC_INMP411_ENABLE
            string "ws url"
            default "ws://192.168.3.27:10095/"
            help
                Set ASR websocket service address.
    endmenu

   menu "UI Configuration"
        config SWITCH86_UI_ENABLE
            bool "Enable UI Configuration"
            default "y"
            help
                Enable this option if you wish to UI Configuration.

        config LV_USE_DEMO_WIDGETS
            depends on !SWITCH86_UI_ENABLE
            bool "USE DEMO WIDGETS"
            default "y"
            help
                Please do not modify this configuration.

        config SWITCH86_UI_OFF_WIFI_SSID
            depends on !SWITCH86_UI_ENABLE
            string "WIFI SSID"
            default ""
            help
                Set wifi ssid.

        config SWITCH86_UI_OFF_WIFI_PASSWORD
            depends on !SWITCH86_UI_ENABLE
            string "WIFI password"
            default ""
            help
                Set wifi password.

        config SWITCH86_UI_OFF_MIOT_USERNAME
            depends on !SWITCH86_UI_ENABLE
            string "MIOT username"
            default ""
            help
                Set MIOT username.

        config SWITCH86_UI_OFF_MIOT_PASSWORD
            depends on !SWITCH86_UI_ENABLE
            string "MIOT password"
            default ""
            help
                Set MIOT password.
    endmenu

endmenu
```
